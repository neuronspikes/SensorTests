/**
 * To use with TCRT5000 Reflective Optical Sensor
 *
 * Build a paper laser printed optical disc generated by 
 * http://www.dgkelectronics.com/inkscape-extension-for-creating-optical-rotary-encoder-discs
 *
 * Build a dual optical sensor to use on digital pins.
 * use 300 ohm for led current limitor (gives 2mm proximity at 5V)
 * use 20K ohm for phototransistor external pullup
 * hysterisis is done by switching internal 20K pullup (managed by this program)
 *
 * sensors must be position at a half phase of each other
 */

// Phototransistors
const int aPin = 2;  // Blue wire
const int bPin = 3; // Green wire
const int ledPowerPin = 9; // PWM, Yellow wire
// Vcc = Purple
// Gnd = Gray


// previous sensor states
boolean aPreviousVal=0;
boolean bPreviousVal=0;

int pulseCount=0;
int ledBright=127; // todo: store/retreive in eeprom

void setup(){
  //start serial connection
  Serial.begin(9600);

  pinMode(aPin, INPUT);  // will be changed dynamically to use pullup
  pinMode(bPin, INPUT);

  pinMode(ledPowerPin, OUTPUT);
  analogWrite(ledPowerPin,ledBright);
}

void loop()
{
  if(Serial.available()){
    char val = Serial.read();
    if(val != -1)
    {
      switch(val)
      {

      case '+':
        ledBright++;
        if(ledBright>255)ledBright=255;

        Serial.println("+");  
        break;
      case '-':
        ledBright--;
        if(ledBright<0)ledBright=0;

        Serial.println("-");   
        break;
      }
      analogWrite(ledPowerPin,ledBright);
    }
  }
  boolean aVal = digitalRead(aPin);
  boolean bVal = digitalRead(bPin); 

  // Detect aberrations
  if((aVal!=aPreviousVal) && (bVal!=bPreviousVal)) 
  {
    Serial.println("-------- Disc timing error! --------"); // Only normal at startup
  }
  else
  {
    if(aVal != aPreviousVal) 
    {
      if(aVal == bVal) pulseCount++;
      if(aVal != bVal) pulseCount--;

      // Hysteresis effect
      pinMode(aPin, (aVal?INPUT_PULLUP:INPUT));  
    }
    else if(bVal != bPreviousVal) 
    {
      if(aVal != bVal) pulseCount++;
      if(aVal == bVal) pulseCount--;

      // Hysteresis effect
      pinMode(bPin, (bVal?INPUT_PULLUP:INPUT));  
    }
  }
  // prepare for next loop
  aPreviousVal=aVal;
  bPreviousVal=bVal;

  // Monitor states
  Serial.print("bright=");  
  Serial.print(ledBright);
  Serial.print("    a=");  
  Serial.print(aVal);
  Serial.print("    b=");  
  Serial.print(bVal);
  Serial.print("    count=");
  Serial.println(pulseCount);

}




